/*&i2c1 {
    
    scd40: scd40@62{
        compatible = "sensirion,sgp40";
        reg = < 0x62 >;
        label = "scd40";
    };
};*/

&spi0 {
    
    epaper: epaper@1{
        compatible = "ultrachip,uc8176";
        reset-gpios = < &gpio0 3 GPIO_ACTIVE_LOW >;
        dc-gpios = < &gpio0 28 GPIO_ACTIVE_LOW >;
        busy-gpios = < &gpio0 2 GPIO_ACTIVE_LOW >;
        height = < 300 >;
        width = < 400 >;
        spi-max-frequency = < 20000000 >;
        reg = < 1 >;
    };
};


// To get started, press Ctrl+Space to bring up the completion menu and view the available nodes.

// You can also use the buttons in the sidebar to perform actions on nodes.
// Actions currently available include:

// * Enabling / disabling the node
// * Adding the bus to a bus
// * Removing the node
// * Connecting ADC channels

// For more help, browse the DeviceTree documentation at https://docs.zephyrproject.org/latest/guides/dts/index.html
// You can also visit the nRF DeviceTree extension documentation at https://nrfconnect.github.io/vscode-nrf-connect/devicetree/nrfdevicetree.html
